#include <behaviors.dtsi>
#include <behaviors/num_word.dtsi> // Requires zmk-auto-layer module.
#include <behaviors/unicode.dtsi> // Requires zmk-unicode module.
#include <zmk-helpers/helper.h> // Requires zmk-helpers module.
#include <dt-bindings/zmk/keys.h>
#ifdef CONFIG_WIRELESS
  #include <dt-bindings/zmk/bt.h>
  #include <dt-bindings/zmk/outputs.h>
  #define _BT_SEL_KEYS_                                                        \
      &bt0_win &bt1_mac &bt BT_SEL 2 &bt BT_SEL 3 &bt BT_CLR
#else
  #define _BT_SEL_KEYS_ &trans &trans &trans &trans &trans
#endif

// Things to do:
// Urob's combos look good for now, potentially make my own later
// Window management keys not finished
// Try local build instead of github actions
// Ink display graphics
// Skip forward/backward functions instead of next/last media

#define DSEND 0
#define QWERTY 1
#define SYM 2
#define NAV 3
#define NUM 4
#define SYS 5
#define MOU 6
#define BTN 7
#define APP 8
#define FN 9

#define XXX &none
#define ___ &trans

/* Global defaults */

#define QUICK_TAP_MS 175

&sk {
  release-after-ms = <900>;
  quick-release;
};

&sl { // Allow sticky mods to chord across sticky layers.
  ignore-modifiers;
};

&uc {
  minimum-length = <4>;
};

&lt {
  flavor = "balanced";
  tapping-term-ms = <200>;
  quick-tap-ms = <QUICK_TAP_MS>;
};


/* Homerow mods */

// old: flavor = "balanced";
#define MAKE_HRM(NAME, HOLD, TAP, TRIGGER_POS)                                 \
  ZMK_HOLD_TAP(NAME, bindings = <HOLD>, <TAP>; flavor = "tap-preferred";       \
               tapping-term-ms = <280>; quick-tap-ms = <QUICK_TAP_MS>;         \
               require-prior-idle-ms = <150>; hold-trigger-on-release;         \
               hold-trigger-key-positions = <TRIGGER_POS>;)

MAKE_HRM(hml, &kp, &kp, KEYS_R THUMBS) // Left-hand HRMs.
MAKE_HRM(hmr, &kp, &kp, KEYS_L THUMBS) // Right-hand HRMs.

// Hack: Make HRM combos tap-only (cf, ZMK issue #544).
#define ZMK_COMBO_8(NAME, TAP, POS, LAYERS, COMBO_MS, IDLE_MS, HOLD, SIDE)     \
  MAKE_HRM(hm_combo_##NAME, &kp, TAP, SIDE THUMBS)                             \
  ZMK_COMBO_6(NAME, &hm_combo_##NAME HOLD 0, POS, LAYERS, COMBO_MS, IDLE_MS)

/* Combos, leader key sequences, mouse emulation */

#include "combos.dtsi" // Must be sourced after HRM-combo hack.
#include "compose.dtsi"
#include "leader.dtsi"
#include "mouse.dtsi"
#include "oskeys.dtsi"


#define HT_CORE                                                                \
  flavor = "tap-preferred";                                                    \
  quick-tap-ms = <220>;                                                        \
  bindings = <&kp>, <&kp>;

ZMK_HOLD_TAP(ht,
    HT_CORE
    tapping-term-ms = <220>;
)

/* Magic-shift & auto-layers */

// Tap: repeat after alpha, else sticky-shift |
// Shift + tap/ double-tap: caps-word | Hold: Shift.
#define MAGIC_SHIFT &magic_shift LSHFT 0
ZMK_HOLD_TAP(magic_shift, bindings = <&kp>, <&magic_shift_tap>;
             flavor = "balanced"; tapping-term-ms = <200>;
             quick-tap-ms = <QUICK_TAP_MS>;)
ZMK_MOD_MORPH(magic_shift_tap, bindings = <&shift_repeat>, <&caps_word>;
              mods = <(MOD_LSFT)>;)
ZMK_ADAPTIVE_KEY(
    shift_repeat, bindings = <&sk LSHFT>;
    repeat {
      trigger-keys = <A B C D E F G H I J K L M N O P Q R S T U V W X Y Z>;
      bindings = <&key_repeat>;
      max-prior-idle-ms = <1200>;
      strict-modifiers;
    };)
&caps_word { // Mods deactivate caps-word, requires PR #1451. [TODO: rebase]
  /delete-property/ ignore-modifiers;
};

// Tap: num-word | double-tap: sticky NUM layer | Hold: activate NUM layer.
#define SMART_NUM &smart_num NUM 0
ZMK_HOLD_TAP(smart_num, bindings = <&mo>, <&num_dance>; flavor = "balanced";
             tapping-term-ms = <200>; quick-tap-ms = <QUICK_TAP_MS>;)
ZMK_TAP_DANCE(num_dance, bindings = <&num_word NUM>, <&sl NUM>;
              tapping-term-ms = <200>;)

// Tap: OS launcher/search | Hold: activate APP layer.
#define APP_LAUNCHER &app_launcher APP 0
ZMK_HOLD_TAP(app_launcher, bindings = <&mo>, <&ok_launcher>;
             flavor = "hold-preferred"; tapping-term-ms = <200>;
             quick-tap-ms = <QUICK_TAP_MS>;)

// Smart-mouse, requires tri-state module.
ZMK_TRI_STATE(
    smart_mouse, bindings = <&tog MOU>, <&none>, <&tog MOU>;
    ignored-key-positions =
        <LT1 LT2 LH0 LH1 RT1 RT2 RT3 RM0 RM1 RM2 RM3 RM4 RB1 RB2 RB3 RH0 RH1>;
    ignored-layers = <MOU NAV APP NUM FN>;)

// Smart-button, requires tri-state module.
ZMK_TRI_STATE(
    smart_button, bindings = <&tog BTN>, <&none>, <&tog BTN>;
    ignored-key-positions =
        <LT4 LT3 LT2 LT1 LT0 RT0 RT1 RT2 RT3 RT4 RT5
         LM4 LM3 LM2 LM1 RM1 RM2 RM3 RM4
         LB4 LB3 LB2 LB1 LB0 RB0 RB1 RB2 RB3 RB4
         LH2 LH1 LH0 RH0 RH1 RH2>;
    ignored-layers = <BTN NAV APP NUM FN>;)

/* Custom behaviors */

// OS-aware app swapper, requires tri-state module.
ZMK_TRI_STATE(swapper, bindings = <&ok_app_mod>, <&kp TAB>, <&ok_app_mod>;
              ignored-key-positions = <LT4 RM1 RM2 RM3 RM4>;)

// Mac (AltTab app) swapper for active application's windows
ZMK_TRI_STATE(window_swapper, bindings = <&ok_app_mod>, <&kp GRAVE>, <&ok_app_mod>;
              ignored-key-positions = <LM4 RM1 RM2 RM3 RM4>;)

ZMK_MOD_MORPH(bspc_morph, bindings = <&kp BSPC>, <&ok_word_bspc>;
              mods = <(MOD_LCTL | MOD_RCTL)>;)

ZMK_HOLD_TAP(lt_bspc, bindings = <&mo>, <&bspc_morph>;
             flavor = "balanced"; tapping-term-ms = <200>;
             quick-tap-ms = <QUICK_TAP_MS>;)

// Define mod-morph with a *single* mod trigger for less repetition.
#define SIMPLE_MORPH(NAME, MOD, BINDING1, BINDING2)                            \
  ZMK_MOD_MORPH(NAME, mods = <(MOD_L##MOD | MOD_R##MOD)>;                      \
                bindings = <BINDING1>, <BINDING2>;)

// Tap: comma | Shift + tap: question mark | Ctrl + shift + tap: underscore.
SIMPLE_MORPH(comma_morph, SFT, &kp COMMA, &comma_inner_morph)
SIMPLE_MORPH(comma_inner_morph, CTL, &kp QUESTION, &kp UNDER)

// Tap: dot | Shift + tap: exclamation mark | Ctrl + shift + tap: grave.
SIMPLE_MORPH(dot_morph, SFT, &kp DOT, &dot_inner_morph)
SIMPLE_MORPH(dot_inner_morph, CTL, &kp EXCL, &kp GRAVE)

// Tap: qmark | Shift + tap: excl.
SIMPLE_MORPH(qexcl, SFT, &kp QMARK, &kp EXCL)

// Tap: left/right parenthesis | Shft + tap: less-than/greater-than.
SIMPLE_MORPH(lpar_lt, SFT, &kp LPAR, &kp LT)
SIMPLE_MORPH(rpar_gt, SFT, &kp RPAR, &kp GT)

// Tap: space | Shift + tap: dot -> space -> sticky shift | Hold: activate assigned layer.
ZMK_HOLD_TAP(lt_spc, bindings = <&mo>, <&spc_morph>; flavor = "balanced"; // "balanced"
             tapping-term-ms = <200>; quick-tap-ms = <QUICK_TAP_MS>;)
SIMPLE_MORPH(spc_morph, SFT, &kp SPACE, &dot_spc)
ZMK_MACRO(dot_spc, bindings = <&kp DOT &kp SPACE &sk LSHFT>; wait-ms = <0>;
          tap-ms = <5>;)

// Tap: backspace | Lshft + tap: delete | Rshft + tap: shift-delete.
ZMK_MOD_MORPH(bs_del, bindings = <&kp BSPC>, <&kp DEL>;
              mods = <(MOD_LSFT|MOD_RSFT)>; keep-mods = <MOD_RSFT>;)

// Tap: copy | double-tap: cut.
ZMK_TAP_DANCE(copy_cut, bindings = <&ok_copy>, <&ok_cut>;
              tapping-term-ms = <200>;)

// Sticky shift + leader.
ZMK_MACRO(leader_sft, bindings = <&sk LSHFT &leader>;)

// Misc aliases. [TODO: clean up]
#define CANCEL        &kp K_CANCEL        // Cancel caps-word & auto-layers.
#define OS_DSK_PREV   &ok_dsk_prev        // Previous desktop.
#define OS_DSK_NEXT   &ok_dsk_next        // Next desktop.
#define OS_DSK_MGR    &ok_dsk_mgr         // Desktop manager.
#define OS_TILE_LEFT  &ok_tile_left       // Tile window left.
#define OS_TILE_RIGHT &ok_tile_right      // Tile window right.
#define OS_TILE_FILL  &ok_tile_fill       // Fill/maximize window.
#define OS_TILE_RST   &ok_tile_restore    // Restore previous window size.
#define OS_MON_NEXT   &ok_monitor_next    // Move window to next monitor.
#define OS_WIN_MIN    &ok_window_minimize // Minimize window.
// #define PIN_WIN &kp LG(LC(LS(Q)))         // Pin window across desktops.
// #define PIN_APP &kp LG(LC(LS(A)))         // Pin application across desktops.

// Meh key shortcuts.
#define MEH(k)       &kp LC(LS(LA(k)))
#define MEH_A        MEH(A)
#define MEH_B        MEH(B)
#define MEH_C        MEH(C)
#define MEH_D        MEH(D)
#define MEH_E        MEH(E)
#define MEH_F        MEH(F)
#define MEH_G        MEH(G)
#define MEH_H        MEH(H)
#define MEH_I        MEH(I)
#define MEH_J        MEH(J)
#define MEH_K        MEH(K)
#define MEH_L        MEH(L)
#define MEH_M        MEH(M)
#define MEH_N        MEH(N)
#define MEH_O        MEH(O)


/* Keymap */

ZMK_CONDITIONAL_LAYER(fn, APP NUM, FN) // APP + NUM --> FN
// ZMK_CONDITIONAL_LAYER(sys, FN NUM, SYS)  // FN + NUM --> SYS

#ifndef ZMK_BASE_LAYER
  #define ZMK_BASE_LAYER(name, LT, RT, LM, RM, LB, RB, LH, RH)                 \
      ZMK_LAYER(name, LT RT LM RM LB RB LH RH)
#endif

ZMK_BASE_LAYER(Dsend,
    //╭─────────────╮ ╭─────────────┬─────────────┬─────────────┬─────────────┬─────────────╮ ╭─────────────┬─────────────┬─────────────┬─────────────┬─────────────╮ ╭─────────────╮
        &ht ESC TAB     &kp X         &kp C         &kp L         &kp F         &kp V       ,   &kp SQT       &kp SEMI      &kp U         &kp P         &kp Q           &mo SYS     ,
    //├─────────────┤ ├─────────────┼─────────────┼─────────────┼─────────────┼─────────────┤ ├─────────────┼─────────────┼─────────────┼─────────────┼─────────────┤ ├─────────────┤
        OS_HT_START     &hml LGUI R   &hml LALT S   &hml LSHFT N  &hml LCTRL T  &kp G       ,   &dot_morph    &hmr LCTRL A  &hmr RSHFT E  &hmr LALT H   &hmr LGUI I     OS_HT_END   ,
    //├─────────────┤ ├─────────────┼─────────────┼─────────────┼─────────────┼─────────────┤ ├─────────────┼─────────────┼─────────────┼─────────────┼─────────────┤ ├─────────────┤
        &kp LCTRL       &kp Z         &kp W         &kp M         &kp D         &kp B       ,   &comma_morph  &kp O         &kp Y         &kp K         &kp J           &kp RWIN    ,
    //╰─────────────╯ ╰─────────────┴─────────────┴─────────────┼─────────────┼─────────────┤ ├─────────────┼─────────────┼─────────────┴─────────────┴─────────────╯ ╰─────────────╯
                                                    APP_LAUNCHER  MAGIC_SHIFT   &lt_bspc NAV 0, &lt NAV RET   &lt_spc SYM 0 SMART_NUM
    //                                            ╰─────────────┴─────────────┴─────────────╯ ╰─────────────┴─────────────┴─────────────╯
)

ZMK_BASE_LAYER(Qwerty,
    //╭─────────────╮ ╭─────────────┬─────────────┬─────────────┬─────────────┬─────────────╮ ╭─────────────┬─────────────┬─────────────┬─────────────┬─────────────╮ ╭─────────────╮
        &ht ESC TAB     &kp Q         &kp W         &kp E         &kp R         &kp T       ,   &kp Y         &kp U         &kp I         &kp O         &kp P           &mo SYS     ,
    //├─────────────┤ ├─────────────┼─────────────┼─────────────┼─────────────┼─────────────┤ ├─────────────┼─────────────┼─────────────┼─────────────┼─────────────┤ ├─────────────┤
        OS_HT_START     &hml LGUI A   &hml LALT S   &hml LSHFT D  &hml LCTRL F  &kp G       ,   &kp H         &hmr LCTRL J  &hmr RSHFT K  &hmr LALT L   &hmr LGUI SEMI  OS_HT_END   ,
    //├─────────────┤ ├─────────────┼─────────────┼─────────────┼─────────────┼─────────────┤ ├─────────────┼─────────────┼─────────────┼─────────────┼─────────────┤ ├─────────────┤
        &kp LCTRL       &kp Z         &kp X         &kp C         &kp V         &kp B       ,   &kp N         &kp M         &comma_morph  &dot_morph    &kp SQT         &kp RWIN    ,
    //╰─────────────╯ ╰─────────────┴─────────────┴─────────────┼─────────────┼─────────────┤ ├─────────────┼─────────────┼─────────────┴─────────────┴─────────────╯ ╰─────────────╯
                                                    APP_LAUNCHER  MAGIC_SHIFT   &lt_bspc NAV 0, &lt NAV RET   &lt_spc SYM 0 SMART_NUM
    //                                            ╰─────────────┴─────────────┴─────────────╯ ╰─────────────┴─────────────┴─────────────╯
)

ZMK_BASE_LAYER(Sym,
    //╭─────────────╮ ╭─────────────┬─────────────┬─────────────┬─────────────┬─────────────╮ ╭─────────────┬─────────────┬─────────────┬─────────────┬─────────────╮ ╭─────────────╮
        ___             &kp AMPS      &kp AT        &kp HASH      &kp DOLLAR    &kp CARET   ,   &kp DQT       &kp LPAR      &kp RPAR      &kp LBKT      &kp RBKT        ___         ,
    //├─────────────┤ ├─────────────┼─────────────┼─────────────┼─────────────┼─────────────┤ ├─────────────┼─────────────┼─────────────┼─────────────┼─────────────┤ ├─────────────┤
        &kp PERCENT     &kp PLUS      &kp MINUS     &kp STAR      &kp SLASH     &kp EQUAL   ,   &kp EXCL      ___           ___           ___           ___             ___         ,
    //├─────────────┤ ├─────────────┼─────────────┼─────────────┼─────────────┼─────────────┤ ├─────────────┼─────────────┼─────────────┼─────────────┼─────────────┤ ├─────────────┤
        ___             &kp TILDE     &kp PIPE      &kp UNDER     &kp COLON     &kp BACKSLASH,  &kp QUESTION  &kp LBRC      &kp RBRC      &kp LT        &kp GT          ___         ,
    //╰─────────────╯ ╰─────────────┴─────────────┴─────────────┼─────────────┼─────────────┤ ├─────────────┼─────────────┼─────────────┴─────────────┴─────────────╯ ╰─────────────╯
                                                    ___           ___           ___         ,   ___           ___           ___
    //                                            ╰─────────────┴─────────────┴─────────────╯ ╰─────────────┴─────────────┴─────────────╯
)

// ADD SHORTCUTS TO THIS LAYER, fn layer most are duplicate/not needed, migrate to this
ZMK_BASE_LAYER(Nav,
    //╭─────────────╮ ╭─────────────┬─────────────┬─────────────┬─────────────┬─────────────╮ ╭─────────────┬─────────────┬─────────────┬─────────────┬─────────────╮ ╭─────────────╮
        ___             &ok_ss_full   &ok_ss_win    &ok_ss_region ___           ___         ,   ___           &ok_addr_bar  &kp PG_UP     &kp PG_DN     &kp INS         ___         ,
    //├─────────────┤ ├─────────────┼─────────────┼─────────────┼─────────────┼─────────────┤ ├─────────────┼─────────────┼─────────────┼─────────────┼─────────────┤ ├─────────────┤
        ___             &ok_redo      ___           &ok_sel_all   &ok_find      ___         ,   ___           OS_HT_LEFT    OS_HT_UP      OS_HT_DOWN    OS_HT_RIGHT     ___         ,
    //├─────────────┤ ├─────────────┼─────────────┼─────────────┼─────────────┼─────────────┤ ├─────────────┼─────────────┼─────────────┼─────────────┼─────────────┤ ├─────────────┤
        ___             &ok_undo      &ok_cut       &ok_copy      &ok_paste     ___         ,   ___           &ok_new_tab   &ok_new_win   &ok_priv_win  ___             ___         ,
    //╰─────────────╯ ╰─────────────┴─────────────┴─────────────┼─────────────┼─────────────┤ ├─────────────┼─────────────┼─────────────┴─────────────┴─────────────╯ ╰─────────────╯
                                                    ___           ___           ___         ,   ___           ___           ___
    //                                            ╰─────────────┴─────────────┴─────────────╯ ╰─────────────┴─────────────┴─────────────╯
)

ZMK_BASE_LAYER(Num,
    //╭─────────────╮ ╭─────────────┬─────────────┬─────────────┬─────────────┬─────────────╮ ╭─────────────┬─────────────┬─────────────┬─────────────┬─────────────╮ ╭─────────────╮
        ___             ___           &kp N7        &kp N8        &kp N9        &kp STAR    ,   ___           ___           ___           ___           ___             ___         ,
    //├─────────────┤ ├─────────────┼─────────────┼─────────────┼─────────────┼─────────────┤ ├─────────────┼─────────────┼─────────────┼─────────────┼─────────────┤ ├─────────────┤
        ___             &kp PLUS      &kp N4        &kp N5        &kp N6        &kp EQUAL   ,   ___           ___           ___           ___           ___             ___         ,
    //├─────────────┤ ├─────────────┼─────────────┼─────────────┼─────────────┼─────────────┤ ├─────────────┼─────────────┼─────────────┼─────────────┼─────────────┤ ├─────────────┤
        ___             &kp MINUS     &kp N1        &kp N2        &kp N3        &kp FSLH    ,   ___           ___           ___           ___           ___             ___         ,
    //╰─────────────╯ ╰─────────────┴─────────────┴─────────────┼─────────────┼─────────────┤ ├─────────────┼─────────────┼─────────────┴─────────────┴─────────────╯ ╰─────────────╯
                                                    &lt APP DOT   &mt LSHFT N0  ___         ,   ___           ___           ___
    //                                            ╰─────────────┴─────────────┴─────────────╯ ╰─────────────┴─────────────┴─────────────╯
)

ZMK_BASE_LAYER(Sys,
    //╭─────────────╮ ╭─────────────┬─────────────┬─────────────┬─────────────┬─────────────╮ ╭─────────────┬─────────────┬─────────────┬─────────────┬─────────────╮ ╭─────────────╮
        CANCEL                                     _BT_SEL_KEYS_                            ,   &kp C_PREV    &kp C_PP      &kp C_NEXT    ___           &kp F22         ___         ,
    //├─────────────┤ ├─────────────┼─────────────┼─────────────┼─────────────┼─────────────┤ ├─────────────┼─────────────┼─────────────┼─────────────┼─────────────┤ ├─────────────┤
        ___             OS_WIN_SEL    OS_MAC_SEL    OS_LIN_SEL    ___           ___         ,   &kp C_VOL_DN  &kp C_MUTE    &kp C_VOL_UP  ___           &kp F23         &kp F24     ,
    //├─────────────┤ ├─────────────┼─────────────┼─────────────┼─────────────┼─────────────┤ ├─────────────┼─────────────┼─────────────┼─────────────┼─────────────┤ ├─────────────┤
        ___             &smart_button &smart_mouse  ___           &bootloader   &sys_reset  ,   &sys_reset    &bootloader   ___           ___           &to DSEND       &to QWERTY  ,
    //╰─────────────╯ ╰─────────────┴─────────────┴─────────────┼─────────────┼─────────────┤ ├─────────────┼─────────────┼─────────────┴─────────────┴─────────────╯ ╰─────────────╯
                                                    ___           ___           ___         ,   ___           ___           ___
    //                                            ╰─────────────┴─────────────┴─────────────╯ ╰─────────────┴─────────────┴─────────────╯
)

ZMK_BASE_LAYER(Mou,
    //╭─────────────╮ ╭─────────────┬─────────────┬─────────────┬─────────────┬─────────────╮ ╭─────────────┬─────────────┬─────────────┬─────────────┬─────────────╮ ╭─────────────╮
        ___             ___           ___           ___           ___           ___         ,   ___           &kp PG_UP     U_MS_U         &kp PG_DN    ___             &tog MOU    ,
    //├─────────────┤ ├─────────────┼─────────────┼─────────────┼─────────────┼─────────────┤ ├─────────────┼─────────────┼─────────────┼─────────────┼─────────────┤ ├─────────────┤
        ___             ___           ___           ___           ___           ___         ,   U_WH_L        U_MS_L        U_MS_D         U_MS_R       U_WH_R          ___         ,
    //├─────────────┤ ├─────────────┼─────────────┼─────────────┼─────────────┼─────────────┤ ├─────────────┼─────────────┼─────────────┼─────────────┼─────────────┤ ├─────────────┤
        ___             ___           ___           ___           ___           ___         ,   ___           &mkp LCLK     &mkp MCLK      &mkp RCLK    ___             ___         ,
    //╰─────────────╯ ╰─────────────┴─────────────┴─────────────┼─────────────┼─────────────┤ ├─────────────┼─────────────┼─────────────┴─────────────┴─────────────╯ ╰─────────────╯
                                                    ___           ___           ___         ,   U_WH_U        U_WH_D        ___
    //                                            ╰─────────────┴─────────────┴─────────────╯ ╰─────────────┴─────────────┴─────────────╯
)

ZMK_BASE_LAYER(Btn,
    //╭─────────────╮ ╭─────────────┬─────────────┬─────────────┬─────────────┬─────────────╮ ╭─────────────┬─────────────┬─────────────┬─────────────┬─────────────╮ ╭─────────────╮
        ___             &ok_undo      &ok_cut       &ok_copy      &ok_paste     &ok_redo    ,   &ok_redo      &ok_paste     &ok_copy      &ok_cut       &ok_undo        &tog BTN    ,
    //├─────────────┤ ├─────────────┼─────────────┼─────────────┼─────────────┼─────────────┤ ├─────────────┼─────────────┼─────────────┼─────────────┼─────────────┤ ├─────────────┤
        ___             &kp LGUI      &kp LALT      &kp LSHFT     &kp LCTRL     ___         ,   ___           &kp LCTRL     &kp LSHFT     &kp LALT      &kp LGUI        ___         ,
    //├─────────────┤ ├─────────────┼─────────────┼─────────────┼─────────────┼─────────────┤ ├─────────────┼─────────────┼─────────────┼─────────────┼─────────────┤ ├─────────────┤
        ___             &ok_undo      &ok_cut       &ok_copy      &ok_paste     &ok_redo    ,   &ok_redo      &ok_paste     &ok_copy      &ok_cut       &ok_undo        ___         ,
    //╰─────────────╯ ╰─────────────┴─────────────┴─────────────┼─────────────┼─────────────┤ ├─────────────┼─────────────┼─────────────┴─────────────┴─────────────╯ ╰─────────────╯
                                                    &mkp MCLK     &mkp LCLK     &mkp RCLK   ,   &mkp RCLK     &mkp LCLK     &mkp MCLK
    //                                            ╰─────────────┴─────────────┴─────────────╯ ╰─────────────┴─────────────┴─────────────╯
)

ZMK_BASE_LAYER(App,
    //╭─────────────╮ ╭─────────────┬─────────────┬─────────────┬─────────────┬─────────────╮ ╭─────────────┬─────────────┬─────────────┬─────────────┬─────────────╮ ╭─────────────╮
        &swapper        &kp LS(TAB)   OS_DSK_PREV   OS_DSK_MGR    OS_DSK_NEXT   ___         ,   MEH_A         MEH_B         MEH_C         MEH_D         MEH_E           ___         ,
    //├─────────────┤ ├─────────────┼─────────────┼─────────────┼─────────────┼─────────────┤ ├─────────────┼─────────────┼─────────────┼─────────────┼─────────────┤ ├─────────────┤
        &window_swapper &kp LSHFT     OS_TILE_LEFT  OS_TILE_FILL  OS_TILE_RIGHT ___         ,   MEH_F         MEH_G         MEH_H         MEH_I         MEH_J           ___         ,
    //├─────────────┤ ├─────────────┼─────────────┼─────────────┼─────────────┼─────────────┤ ├─────────────┼─────────────┼─────────────┼─────────────┼─────────────┤ ├─────────────┤
        ___             ___           OS_MON_NEXT   OS_WIN_MIN    OS_TILE_RST   ___         ,   MEH_K         MEH_L         MEH_M         MEH_N         MEH_O           ___         ,
    //╰─────────────╯ ╰─────────────┴─────────────┴─────────────┼─────────────┼─────────────┤ ├─────────────┼─────────────┼─────────────┴─────────────┴─────────────╯ ╰─────────────╯
                                                    ___           ___           ___         ,   ___           ___           ___
    //                                            ╰─────────────┴─────────────┴─────────────╯ ╰─────────────┴─────────────┴─────────────╯
)

ZMK_BASE_LAYER(Fn,
    //╭─────────────╮ ╭─────────────┬─────────────┬─────────────┬─────────────┬─────────────╮ ╭─────────────┬─────────────┬─────────────┬─────────────┬─────────────╮ ╭─────────────╮
        ___             &kp F12       &kp F7        &kp F8        &kp F9        &kp PSCRN   ,   ___           ___           ___           ___           ___             ___         ,
    //├─────────────┤ ├─────────────┼─────────────┼─────────────┼─────────────┼─────────────┤ ├─────────────┼─────────────┼─────────────┼─────────────┼─────────────┤ ├─────────────┤
        ___             &kp F11       &kp F4        &kp F5        &kp F6        &kp SLCK    ,   ___           ___           ___           ___           ___             ___         ,
    //├─────────────┤ ├─────────────┼─────────────┼─────────────┼─────────────┼─────────────┤ ├─────────────┼─────────────┼─────────────┼─────────────┼─────────────┤ ├─────────────┤
        ___             &kp F10       &kp F1        &kp F2        &kp F3        &kp PAUSE_BREAK, ___           ___           ___           ___           ___             ___         ,
    //╰─────────────╯ ╰─────────────┴─────────────┴─────────────┼─────────────┼─────────────┤ ├─────────────┼─────────────┼─────────────┴─────────────┴─────────────╯ ╰─────────────╯
                                                    ___           ___           ___         ,   ___           ___           ___
    //                                            ╰─────────────┴─────────────┴─────────────╯ ╰─────────────┴─────────────┴─────────────╯
)

/* vim: set ft=c tw=146: */

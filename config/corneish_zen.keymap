/* source key position labels */
// #include "zmk-helpers/key-labels/36.h"
#include "zmk-helpers/key-labels/42.h"

/* map Zen's extra keys */
#define X_LT  &kp TAB
#define X_LM  &kp HOME
#define X_LB  &kp LCTRL

#define X_RT  &mo SYS
#define X_RM  &kp END
#define X_RB  &kp RWIN

#define X_LH  SMART_NUM      // thumb row, left
#define X_RH  &smart_mouse   // thumb row, right


// #define X_LH  &kp LGUI      // thumb row, left
// #define X_RH  &smart_mouse  // thumb row, right

/* activate bluetooth */
#define CONFIG_WIRELESS

/* source the main keymap */
#include "base.keymap"

/* use 6-column layout for Zen */
/{ chosen { zmk,physical-layout = &foostan_corne_6col_layout; }; };
